// boards/shields/f/f_right.overlay
#include "f.dtsi"

/ {
    // Optional: right-specific physical layout choice
    // chosen { zmk,physical-layout = &default_layout; };
};

&kscan {
    // Only add overrides if the right half differs from f.dtsi.
    // Example: leave empty to inherit everything from f.dtsi.
};
