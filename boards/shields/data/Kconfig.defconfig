## boards/shields/data/Kconfig.defconfig
```kconfig
if SHIELD_DATA_LEFT

config ZMK_KEYBOARD_NAME
    default "data"

config ZMK_SPLIT_ROLE_CENTRAL
    default y

endif # SHIELD_DATA_LEFT

if SHIELD_DATA_LEFT || SHIELD_DATA_RIGHT

config ZMK_SPLIT
    default y

endif # SHIELD_DATA_LEFT || SHIELD_DATA_RIGHT
```

## boards/shields/data/Kconfig.shield
```kconfig
config SHIELD_DATA_LEFT
    def_bool $(shields_list_contains,data_left)

config SHIELD_DATA_RIGHT
    def_bool $(shields_list_contains,data_right)
```

## boards/shields/f/Kconfig.defconfig
```kconfig
if SHIELD_F_LEFT

config ZMK_KEYBOARD_NAME
    default "filip-dact"

config ZMK_SPLIT_ROLE_CENTRAL
    default y

endif # SHIELD_F_LEFT

if SHIELD_F_LEFT || SHIELD_F_RIGHT

config ZMK_SPLIT
    default y

endif # SHIELD_F_LEFT || SHIELD_F_RIGHT
```

## boards/shields/f/Kconfig.shield
```kconfig
config SHIELD_F_LEFT
    def_bool $(shields_list_contains,f_left)

config SHIELD_F_RIGHT
    def_bool $(shields_list_contains,f_right)
```

## boards/shields/f_dactyl/Kconfig.defconfig
```kconfig
if SHIELD_F_DACTYL_LEFT

config ZMK_KEYBOARD_NAME
    default "f-dactyl"

config ZMK_SPLIT_ROLE_CENTRAL
    default y

endif # SHIELD_F_DACTYL_LEFT

if SHIELD_F_DACTYL_LEFT || SHIELD_F_DACTYL_RIGHT

config ZMK_SPLIT
    default y

endif # SHIELD_F_DACTYL_LEFT || SHIELD_F_DACTYL_RIGHT
```

## boards/shields/f_dactyl/Kconfig.shield
```kconfig
config SHIELD_F_DACTYL_LEFT
    def_bool $(shields_list_contains,f_dactyl_left)

config SHIELD_F_DACTYL_RIGHT
    def_bool $(shields_list_contains,f_dactyl_right)
```

## boards/shields/half/Kconfig.defconfig
```kconfig
if SHIELD_HALF

config ZMK_KEYBOARD_NAME
    default "half"

endif # SHIELD_HALF
```
